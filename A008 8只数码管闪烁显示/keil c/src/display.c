/************************************************************************************************** 
input.h:开关量输入程序如单个按键，按钮、接近开关等

***************************************************************************************************/


#include "reg52.h"
#include "config.h"
#include "intrins.h"



uch8 segcode[]={0xc0,0xf9,0xa4,0xb0,0x99,0x92,0x82,0xf8,0x80,0x90,0x88,0x83,0xc6,0xa1,0x86,0x8e};//共阳极显示码
uint16 num_work=4267;
uch8 num[4];

/**********************8位数码管闪烁显示函数***********************************/
void dis_8wseg_shansuo()
{	
    uch8 i,en_seg,n;

    en_seg=0x01;//0000 0001
	for(i=0;i<8;i++)
	{
		P2=0x00;//关闭所有位选
		P0=segcode[i];//把需要显示的字形码送至P0口
  		P2=en_seg;    //打开相应数码管位选端口
		delay1ms24m(1);//延时1MS
		en_seg=_crol_(en_seg,1);//获取下一次数码管使能参数
	}
	
	n++;
	if(n==30)
	{
		P2=0x00;//关闭所有位选
		P0=0xff;
		delay1ms24m(300);
		n=0;
    }

}

/******************************************************************************/


/*******************************************************************/
void display()
{
	uch8 i;
	uch8 en_seg;

	en_seg=0x01;
/*	for(i=0;i<8;i++)
	{
		P2=0x00;
		P0=segcode[i];		 //
		P2=en_seg;
        delay1ms(1);
        en_seg=_crol_(en_seg,1);
	}
*/
    num[0]=num_work/1000;
    num[1]=num_work%1000/100;
    num[2]=num_work%100/10;
    num[3]=num_work%10;

	for(i=0;i<4;i++)
	{
		P2=0x00;
		P0=segcode[num[i]];
        P2=en_seg;
		delay1ms(1);
        en_seg=_crol_(en_seg,1);
    }
     
}

/****************************************************************************/
