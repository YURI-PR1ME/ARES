/********************************************************************************************
*********************************************************************************************/

//加载头文件
#include "reg52.h"

//宏定义
#define uint8 unsigned int
#define uch8 unsigned char


//函数声明
void delay(uint8 a);

//花样输出数组
uch8 code Pattern_P0[]=
{
 0xfc,0xf9,0xf3,0xe7,0xcf,0x9f,0x3f,0x7f,0xff,0xff,0xff,0xff,0xff,0xff,0xff,0xff,
 0xe7,0xdb,0xbd,0x7e,0xbd,0xdb,0xe7,0xff,0xe7,0xc3,0x81,0x00,0x81,0xc3,0xe7,0xff,
 0xaa,0x55,0x18,0xff,0xf0,0x0f,0x00,0xff,0xf8,0xf1,0xe3,0xc7,0x8f,0x1f,0x3f,0x7f,
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 0x00,0xff,0x00,0xff,0x00,0xff,0x00,0xff
};
uch8 code Pattern_P2[]=
{
 0xff,0xff,0xff,0xff,0xff,0xff,0xff,0xfe,0xfc,0xf9,0xf3,0xe7,0xcf,0x9f,0x3f,0xff,
 0xe7,0xdb,0xbd,0x7e,0xbd,0xdb,0xe7,0xff,0xe7,0xc3,0x81,0x00,0x81,0xc3,0xe7,0xff,
 0xaa,0x55,0x18,0xff,0xf0,0x0f,0x00,0xff,0xf8,0xf1,0xe3,0xc7,0x8f,0x1f,0x3f,0x7f,
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 0x00,0xff,0x00,0xff,0x00,0xff,0x00,0xff
};


void main()
{
	uch8 i;

	while(1)
	{
		for(i=0;i<136;i++)
		{
			P0=Pattern_P0[i];
			P2=Pattern_P2[i];
			delay(150);
		}
	}
}

void delay(uint8 a)
{
	uint8 b;
	while(a--)
	{
		for(b=120;b>0;b--);
	}
}
