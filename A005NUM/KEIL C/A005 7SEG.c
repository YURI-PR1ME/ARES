/************************************************************************************************
*************************************************************************************************/


//调用头文件
#include "reg52.h"


//数据类型的宏定义
#define uch8 unsigned char
#define uint16 unsigned int


//IO端口配置


//函数声明
void delay(uint16 a);


//变量定义
uch8 code data_dis[]=
{
 	0xc0,0xf9,0xa4,0xb0,0x99,0x92,0x82,0xf8,0x80,0x90
};



//主程序
main()
{
	uch8 i;

	//初始化
	P0=0x00;

	//循环执行程序     
	 while(1)
	 {
		for(i=0;i<10;i++)
		{
		   P0=~data_dis[i];
		   delay(400);	
		}

	 }

}


//延时函数
void delay(uint16 a)
{
	uch8 b;
	while(a--)
	{
		for(b=120;b>0;b--);
	}

}







